# file: test_flash.ioc
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Mcu.Family=STM32F0
Mcu.Name=STM32F042F4Px
Mcu.Package=TSSOP20
PA13.Mode=Serial_Wire
PA13.Signal=SYS_SWDIO
PA14.Mode=Serial_Wire
PA14.Signal=SYS_SWCLK
PB1.GPIO_Label=LED
PB1.PinState=GPIO_PIN_SET
PB1.Signal=GPIO_Output
PF0-OSC_IN.Mode=HSE-External-Oscillator
PF0-OSC_IN.Signal=RCC_OSC_IN
PF1-OSC_OUT.Mode=HSE-External-Oscillator
PF1-OSC_OUT.Signal=RCC_OSC_OUT
ProjectManager.HeapSize=0x200
ProjectManager.StackSize=0x400
ProjectManager.TargetToolchain=STM32CubeIDE
RCC.AHBFreq_Value=48000000
RCC.APB1Freq_Value=48000000
RCC.APB1TimFreq_Value=48000000
RCC.HCLKFreq_Value=48000000
RCC.HSE_VALUE=24000000
RCC.PLLSourceVirtual=RCC_PLLSOURCE_HSE
RCC.SYSCLKFreq_VALUE=48000000
RCC.SYSCLKSource=RCC_SYSCLKSOURCE_PLLCLK
board=custom

// file: Core/Src/main.c
/* USER CODE BEGIN Header */
/**
  ******************************************************************************
  * @file           : main.c
  * @brief          : Main program body
  ******************************************************************************
  * @attention
  *
  * Copyright (c) 2024 STMicroelectronics.
  * All rights reserved.
  *
  * This software is licensed under terms that can be found in the LICENSE file
  * in the root directory of this software component.
  * If no LICENSE file comes with this software, it is provided AS-IS.
  *
  ******************************************************************************
  */
/* USER CODE END Header */
#include "main.h"

/* USER CODE BEGIN PTD */
typedef struct Sensors_calibration_t {
  uint32_t steering_correction_factor;
  uint32_t damper_left_correction_factor;
  uint32_t damper_right_correction_factor;
  uint16_t min_steering;
  uint16_t max_steering;
  uint16_t min_damper_left;
  uint16_t max_damper_left;
  uint16_t min_damper_right;
  uint16_t max_damper_right;

} Sensors_calibration_t;
/* USER CODE END PTD */

/* USER CODE BEGIN PD */
#define FLASH_LAST_PAGE 0x0800FFFF
#define FLASH_PAGE_63 0x08007C00
/* USER CODE END PD */

void SystemClock_Config(void);
static void MX_GPIO_Init(void);

/* USER CODE BEGIN 0 */
uint8_t bool = 1;

Sensors_calibration_t sensors_calibration_write = {
		.min_steering = 0x0002,
		.max_steering = 0x0031,
		.steering_correction_factor = 0x00000001,
		.min_damper_left = 0x0002,
		.max_damper_left = 0x0031,
		.damper_left_correction_factor = 0x00000001,
		.min_damper_right = 0x0012,
		.max_damper_right = 0x0037,
		.damper_right_correction_factor = 0x00000001
};

Sensors_calibration_t sensors_calibration_read = {
		.min_steering = 0,
		.max_steering = 0,
		.steering_correction_factor = 0,
		.min_damper_left = 0,
		.max_damper_left = 0,
		.damper_left_correction_factor = 0,
		.min_damper_right = 0,
		.max_damper_right = 0,
		.damper_right_correction_factor = 0
};

static uint32_t GetPage(uint32_t Address)
{
 for (int indx=0; indx<64; indx++)
 {
     if((Address < (0x08000000 + (1024 *(indx+1))) ) && (Address >= (0x08000000 + 1024*indx)))
     {
         return (0x08000000 + 1024*indx);
     }
 }
 return 0;
}

uint32_t store_flash_memory(uint32_t memory_address, Sensors_calibration_t*data, int number_words)
{
	//We declare some useful variables
	static FLASH_EraseInitTypeDef Erase_Init_Struct;
	uint32_t PAGEError;

	//We unlock the memory in order to write
	HAL_FLASH_Unlock();

	//Erase the USER FLASH area
	uint32_t start_page = GetPage(memory_address); //0x0800FFF
	uint32_t end_page_address = memory_address + number_words*4;
	uint32_t end_page = GetPage(end_page_address); //0x0800FFE7

	/*
	if(start_page == 0 || end_page == 0)
	{
		return 1;
	}
	*/

	Erase_Init_Struct.NbPages = ((end_page - start_page)/FLASH_PAGE_SIZE) + 1;
	Erase_Init_Struct.PageAddress = start_page;
	Erase_Init_Struct.TypeErase = FLASH_TYPEERASE_PAGES;

	if(HAL_FLASHEx_Erase(&Erase_Init_Struct, &PAGEError) != HAL_OK)
	{
		return 1; //We return if there is an error while erasing
	}

	//We create some useful pointers to access struct data
	uint32_t * px = (uint32_t *)data;
	uint16_t * gx = (uint16_t *)data;

	//We write data into FLASH
	for(int n=0; n<3; n++)
	{
		if(HAL_FLASH_Program(FLASH_TYPEPROGRAM_WORD, memory_address, *(px + n)) != HAL_OK)
			{
				return 1;
			}
		memory_address += 4;
	}

	for(int j=6; j<12; j++)
	{
		if(HAL_FLASH_Program(FLASH_TYPEPROGRAM_HALFWORD, memory_address, *(gx + j)) != HAL_OK)
		{
			return 1;
		}
		memory_address += 2;
	}

	//We lock the memory to prevent writing
	HAL_FLASH_Lock();

	return 0;
};

uint32_t read_flash_memory(uint32_t memory_address, Sensors_calibration_t*data, int number_words)
{
	uint32_t * px = (uint32_t *)data;
	uint16_t * gx = (uint16_t *)data;

	for(int n=0; n<3; n++)
	{
		*(px+n) = *(__IO uint32_t *)memory_address;
		memory_address += 4;

	}

	for(int j = 6; j < 12; j++)
	{
		*(gx+j) = *(__IO uint16_t *)memory_address;
		memory_address += 2;
	}
	return 0;
}
/* USER CODE END 0 */

int main(void)
{

  /* MCU Configuration--------------------------------------------------------*/

  /* Reset of all peripherals, Initializes the Flash interface and the Systick. */
  HAL_Init();

  /* Configure the system clock */
  SystemClock_Config();

  /* Initialize all configured peripherals */
  MX_GPIO_Init();

  /* Infinite loop */
  /* USER CODE BEGIN WHILE */
  while (1)
  {
	  if(bool != 0)
	  {
		  bool = 0;

		  if(store_flash_memory(FLASH_PAGE_63, &sensors_calibration_write, 6) == 0)
			{
			  HAL_GPIO_WritePin(GPIOB, LED_Pin, GPIO_PIN_RESET);

			  HAL_Delay(1000);

			  if(read_flash_memory(FLASH_PAGE_63, &sensors_calibration_read, 6) == 0)
			  {
				  HAL_GPIO_WritePin(GPIOB, LED_Pin, GPIO_PIN_SET);
			  }
			}
	  } else
	  {
		HAL_GPIO_TogglePin(GPIOB, LED_Pin);
	  }
    /* USER CODE END WHILE */

  }
}

void SystemClock_Config(void)
{
  RCC_OscInitTypeDef RCC_OscInitStruct = {0};
  RCC_ClkInitTypeDef RCC_ClkInitStruct = {0};

  /** Initializes the RCC Oscillators according to the specified parameters
  * in the RCC_OscInitTypeDef structure.
  */
  RCC_OscInitStruct.OscillatorType = RCC_OSCILLATORTYPE_HSE;
  RCC_OscInitStruct.HSEState = RCC_HSE_ON;
  RCC_OscInitStruct.PLL.PLLState = RCC_PLL_ON;
  RCC_OscInitStruct.PLL.PLLSource = RCC_PLLSOURCE_HSE;
  RCC_OscInitStruct.PLL.PLLMUL = RCC_PLL_MUL2;
  RCC_OscInitStruct.PLL.PREDIV = RCC_PREDIV_DIV1;
  if (HAL_RCC_OscConfig(&RCC_OscInitStruct) != HAL_OK)
  {
    Error_Handler();
  }

  /** Initializes the CPU, AHB and APB buses clocks
  */
  RCC_ClkInitStruct.ClockType = RCC_CLOCKTYPE_HCLK|RCC_CLOCKTYPE_SYSCLK
                              |RCC_CLOCKTYPE_PCLK1;
  RCC_ClkInitStruct.SYSCLKSource = RCC_SYSCLKSOURCE_PLLCLK;
  RCC_ClkInitStruct.AHBCLKDivider = RCC_SYSCLK_DIV1;
  RCC_ClkInitStruct.APB1CLKDivider = RCC_HCLK_DIV1;

  if (HAL_RCC_ClockConfig(&RCC_ClkInitStruct, FLASH_LATENCY_1) != HAL_OK)
  {
    Error_Handler();
  }
}

static void MX_GPIO_Init(void)
{
  GPIO_InitTypeDef GPIO_InitStruct = {0};

  /* GPIO Ports Clock Enable */
  __HAL_RCC_GPIOF_CLK_ENABLE();
  __HAL_RCC_GPIOB_CLK_ENABLE();
  __HAL_RCC_GPIOA_CLK_ENABLE();

  /*Configure GPIO pin Output Level */
  HAL_GPIO_WritePin(LED_GPIO_Port, LED_Pin, GPIO_PIN_SET);

  /*Configure GPIO pin : LED_Pin */
  GPIO_InitStruct.Pin = LED_Pin;
  GPIO_InitStruct.Mode = GPIO_MODE_OUTPUT_PP;
  GPIO_InitStruct.Pull = GPIO_NOPULL;
  GPIO_InitStruct.Speed = GPIO_SPEED_FREQ_LOW;
  HAL_GPIO_Init(LED_GPIO_Port, &GPIO_InitStruct);

}

void Error_Handler(void)
{
  __disable_irq();
  while (1)
  {
  }
}
